## conf/layer.conf
```bitbake
# We have a conf and classes directory, append to BBPATH
BBPATH .= ":${LAYERDIR}"

# We have a recipes directory, add to BBFILES
BBFILES += "${LAYERDIR}/recipes*/*/*.bb ${LAYERDIR}/recipes*/*/*.bbappend"

BBFILE_COLLECTIONS += "meta-igep"
BBFILE_PATTERN_meta-igep := "^${LAYERDIR}/"
BBFILE_PRIORITY_meta-igep = "10"
```

## conf/machine/igep0020.conf
```bitbake
#@TYPE: Machine
#@NAME: IGEP0020 machine
#@DESCRIPTION: Machine configuration for the http://www.myigep.com/ IGEP v2.x boards

PREFERRED_PROVIDER_virtual/xserver = "xserver-xorg"
XSERVER = "xserver-xorg \
           xf86-input-evdev \
           xf86-input-mouse \
           xf86-video-omapfb \
           xf86-input-keyboard"

# Only has DVI connector for external screen
GUI_MACHINE_CLASS = "bigscreen"

require conf/machine/include/omap3.inc

#PREFERRED_PROVIDER_virtual/kernel = "linux-omap"
#PREFERRED_VERSION_linux-omap = "2.6.39"

#PREFERRED_PROVIDER_virtual/kernel = "linux-igep2"

PREFERRED_PROVIDER_virtual/kernel = "linux"

KERNEL_IMAGETYPE = "uImage"

UBOOT_MACHINE = "igep0020_config"

XLOAD_MACHINE = "igep0020-flash_config"

IMAGE_FSTYPES += "tar.bz2 ubi"

# Guesswork
SERIAL_CONSOLE = "115200 ttyO2"

#EXTRA_IMAGECMD_jffs2 = "-lnp -e 0x40000 -s 4096"

# 512MB OneNAND:
MKUBIFS_ARGS = "-m 4096 -e 258048 -c 1990"
UBINIZE_ARGS = "-m 4096 -p 256KiB -s 1024"

# 512MB NAND:
#MKUBIFS_ARGS = "-m 2048 -e 129024 -c 4052"
#UBINIZE_ARGS = "-m 2048 -p 128KiB -s 512"

MACHINE_FEATURES = "kernel26 screen apm usbgadget usbhost vfat alsa"
```

## conf/machine/igep0030.conf
```bitbake
#@TYPE: Machine
#@NAME: IGEP COM MODULE AM/DM37x
#@DESCRIPTION: Machine configuration for the IGEP COM MODULE AM/DM37x Processor Board

# Hard floating point abi.
DEFAULTTUNE ?= "cortexa8hf-neon"
include conf/machine/include/tune-cortexa8.inc

# Common options
require conf/machine/include/igep00x0.inc

# Add extra specific machine packages
MACHINE_EXTRA_RRECOMMENDS += " linux-firmware-sd8686"

# Debug Serial Console
SERIAL_CONSOLE = "115200 ttyO2"

# The U-Boot target platform configuration.
UBOOT_MACHINE = "igep0030_nand_config"

IMAGE_FSTYPES += " ubi"

# do ubiattach /dev/ubi_ctrl -m 4
# From dmesg:
# UBI: smallest flash I/O unit:    2048
# UBI: logical eraseblock size:    129024 bytes
# from ubiattach stdout:
# UBI device number 0, total 4052 LEBs
# 
MKUBIFS_ARGS = "-m 2048 -e 129024 -c 4052"

# do ubiattach /dev/ubi_ctrl -m 4
# from dmesg:
# UBI: smallest flash I/O unit:    2048
# UBI: physical eraseblock size:   131072 bytes (128 KiB)
# UBI: sub-page size:              512
UBINIZE_ARGS = "-m 2048 -p 128KiB -s 512"
```

## conf/machine/igep0033.conf
```bitbake
#@TYPE: Machine
#@NAME: IGEP COM AQUILA AM335x
#@DESCRIPTION: Machine configuration for the IGEP COM AQUILA AM335x Processor Board

# Hard floating point abi.
DEFAULTTUNE ?= "cortexa8hf-neon"
include conf/machine/include/tune-cortexa8.inc

# Common options
require conf/machine/include/igep00x0.inc

# Debug Serial Console
SERIAL_CONSOLE = "115200 ttyO0"

# The Kernel target configuration.
KERNEL_DEVICETREE = "am335x-base0033.dtb"

# The U-Boot target platform configuration.
UBOOT_MACHINE = "am335x_igep0033_config"
```

## conf/machine/igep00x0.conf
```bitbake
#@TYPE: Machine
#@NAME: IGEP tech machines
#@DESCRIPTION: Machine configuration for IGEP tech based machines.

PREFERRED_PROVIDER_virtual/xserver ?= "xserver-xorg"
XSERVER ?= "xserver-xorg \
           xf86-input-evdev \
           xf86-input-mouse \
           xf86-video-omapfb \
           xf86-input-keyboard"

# Ship all kernel modules by default
MACHINE_EXTRA_RRECOMMENDS = " kernel-modules"

# Allow for MMC booting (required by the NAND-less Beagleboard XM)
#EXTRA_IMAGEDEPENDS += "u-boot x-load"

# Uncomment the following line to enable the hard floating point abi. Note that
# this breaks some binary libraries and 3D (neither of which ship with
# meta-yocto). For maximum compatibility, leave this disabled.
#DEFAULTTUNE ?= "cortexa8hf-neon"
include conf/machine/include/tune-cortexa8.inc

IMAGE_FSTYPES += "tar.bz2"

# 512MB OneNAND:
#MKUBIFS_ARGS = "-m 4096 -e 258048 -c 1990"
#UBINIZE_ARGS = "-m 4096 -p 256KiB -s 1024"

# 512MB NAND:
#MKUBIFS_ARGS = "-m 2048 -e 129024 -c 4052"
#UBINIZE_ARGS = "-m 2048 -p 128KiB -s 512"

# 2.6.37 and later kernels use OMAP_SERIAL, ttyO2
# earlier kernels use ttyS2
SERIAL_CONSOLE = "115200 ttyO2"

PREFERRED_PROVIDER_virtual/kernel ?= "linux"

KERNEL_IMAGETYPE = "uImage"

# IGEP-based boards can have two different flash memories and u-boot
# uses different configuration options for each one.
# Choose your configuration according to your memory type.
# NAND flash memory:
# UBOOT_MACHINE = "igep0020_nand"
# OneNAND flash memory:
UBOOT_MACHINE = "igep0020_config"
UBOOT_ENTRYPOINT = "0x80008000"
UBOOT_LOADADDRESS = "0x80008000"
SPL_BINARY = "MLO"

MACHINE_FEATURES = "apm usbgadget usbhost vfat alsa"
```

## conf/machine/include/igep00x0.inc
```bitbake
# X Window System
PREFERRED_PROVIDER_virtual/xserver ?= "xserver-xorg"
XSERVER ?= "xserver-xorg \
           xf86-input-evdev \
           xf86-input-mouse \
           xf86-video-fbdev \
           xf86-input-keyboard"

# Linux Kernel
PREFERRED_PROVIDER_virtual/kernel ?= "linux"
KERNEL_IMAGETYPE ?= "zImage"

# A list of machine-specific packages to install as part of the image.
MACHINE_EXTRA_RRECOMMENDS += " kernel-modules kernel-devicetree virtual/bootloader"

# The entry point for the U-Boot image.
UBOOT_ENTRYPOINT = "0x80008000"
# The load address for the U-Boot image.
UBOOT_LOADADDRESS = "0x80008000"
# The suffix used for the U-Boot image.
UBOOT_SUFFIX ?= "img"
# The binary used for the U-Boot SPL image.
SPL_BINARY ?= "MLO"

# Specifies the format of the root filesystem.
IMAGE_FSTYPES += "tar.bz2"

# List of hardware features the MACHINE supports.
MACHINE_FEATURES ?= "alsa bluetooth usbgadget usbhost wifi"
```
